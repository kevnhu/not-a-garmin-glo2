## main/Kconfig.projbuild
```kconfig
menu "ForeFlight GPS Configuration"

    config GPS_UART_NUM
        int "GPS UART port number"
        default 2
        help
            UART port number for GPS module (UART2 recommended)

    config GPS_RX_PIN
        int "GPS RX GPIO"
        default 16
        help
            GPIO pin connected to GPS TX

    config GPS_TX_PIN
        int "GPS TX GPIO"
        default 17
        help
            GPIO pin connected to GPS RX

    config GPS_BAUD_RATE
        int "GPS baud rate"
        default 115200
        help
            Baud rate for GPS communication

    config WIFI_SSID
        string "WiFi AP SSID"
        default "ForeFlight GPS"
        help
            WiFi access point name visible to devices

endmenu
```

## sdkconfig.defaults
```kconfig
# WiFi
CONFIG_ESP_WIFI_SOFTAP_SUPPORT=y

# Serial flasher config
CONFIG_ESPTOOLPY_BAUD_921600B=y

# Compiler options for performance
CONFIG_COMPILER_OPTIMIZATION_SIZE=y

# FreeRTOS
CONFIG_FREERTOS_HZ=1000

# Main task stack size
CONFIG_ESP_MAIN_TASK_STACK_SIZE=4096
```
